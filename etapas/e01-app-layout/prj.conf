## CMakeLists.txt
```
cmake_minimum_required(VERSION 3.20.0)

find_package(Zephyr REQUIRED HINTS $ENV{ZEPHYR_BASE})

project(e01_app_layout)

target_include_directories(app PRIVATE include)

target_sources(app PRIVATE src/main.c src/saludos.c)
target_sources_ifdef(CONFIG_FEATURE_CONDITIONAL app PRIVATE src/feat_conditional.c)
```

## Kconfig
```
config FEATURE_CONDITIONAL
    bool "Habilitar feature condicional"
    default n

source "Kconfig.zephyr"
```

## prj.conf
```kconfig
CONFIG_PRINTK=y
CONFIG_MAIN_STACK_SIZE=3072
```

## src/main.c
```c
#include <zephyr/kernel.h>

#include "saludos.h"

int main(void)
{
    saludo_base();
    return 0;
}
```

## src/feat_conditional.c
```c
#include "feat_conditional.h"

#include <zephyr/sys/printk.h>

void feature_conditional(void)
{
    printk("Feature conditional is enabled!\n");
}
```
