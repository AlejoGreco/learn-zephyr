## CMakeLists.txt
```
cmake_minimum_required(VERSION 3.20.0)

find_package(Zephyr REQUIRED HINTS $ENV{ZEPHYR_BASE})

project(e02_kconfig)

target_include_directories(app PRIVATE include)

target_sources(app PRIVATE src/main.c src/saludos.c)
target_sources_ifdef(CONFIG_FEATURE_CONDITIONAL app PRIVATE src/feat_conditional.c)
```

## Kconfig
```
mainmenu "Configuracion de la aplicacion e02_kconfig"

menu "Mi aplicacion"

config FEATURE_CONDITIONAL
    bool "Habilitar feature condicional"
    default n
    depends on PRINTK
    help
        Mensaje por consola para comprobar la correcta activacion del modulo.
        Tiene solo fines didacticos, para familiarizacion de .conf y Kconfig

choice FEATURE_CONDITIONAL_SPEED_COMM
    prompt "Velocidad de comunicacion de la feat_conditional"
    depends on FEATURE_CONDITIONAL
    default FEATURE_CONDITIONAL_9600_BAUD

    help
        Config de prueba para fines didacticos.
        Simula velocidad de comunicacion UART  del modulo

    config FEATURE_CONDITIONAL_9600_BAUD
        bool "9600 baud"
    
    config FEATURE_CONDITIONAL_115200_BAUD
        bool "115200 baud"
    
    config FEATURE_CONDITIONAL_921600_BAUD
        bool "921600 baud"

endchoice

config FEATURE_CONDITIONAL_BAUDRATE
    int
    default 9600 if FEATURE_CONDITIONAL_9600_BAUD
    default 115200 if FEATURE_CONDITIONAL_115200_BAUD
    default 921600 if FEATURE_CONDITIONAL_921600_BAUD

config FEATURE_CONDITIONAL_TIMEOUT
    int "Tiempo de espera de la feat_conditional"
    depends on FEATURE_CONDITIONAL
    range 50 1000
    default 100
    help
        Config de prueba para fines didacticos.
        Simula tiempo de espera de la feat_conditional

config FEATURE_CONDITIONAL_USE_LOG
    bool "Usar subsistema de logging en feat_conditional"
    depends on FEATURE_CONDITIONAL && LOG
    default n
    help
        Config de prueba para fines didacticos.
        Emite mensajes del modulo con LOG_INF en lugar de printk.
        El subsistema puede condicionar la compilacion de modulos.

endmenu

source "Kconfig.zephyr"
```

## prj.conf
```kconfig
CONFIG_PRINTK=y
CONFIG_LOG=n
CONFIG_MAIN_STACK_SIZE=3072
CONFIG_FEATURE_CONDITIONAL=y
CONFIG_FEATURE_CONDITIONAL_115200_BAUD=y
CONFIG_FEATURE_CONDITIONAL_TIMEOUT=200
```

## src/main.c
```c
#include <zephyr/kernel.h>

#include "saludos.h"
#include "feat_conditional.h"

int main(void)
{
    saludo_base();

    if (IS_ENABLED(CONFIG_FEATURE_CONDITIONAL)) {
        feature_conditional();
        feature_conditional_config();
    }
    else {
        printk("Feature conditional is disabled!\n");
    }

    return 0;
}
```

## include/feat_conditional.h
```c
#ifndef FEAT_CONDITIONAL_H_
#define FEAT_CONDITIONAL_H_

void feature_conditional(void);
void feature_conditional_config(void);

#endif /* FEAT_CONDITIONAL_H_ */
```

## include/saludos.h
```c
#ifndef SALUDOS_H_
#define SALUDOS_H_

void saludo_base(void);

#endif /* SALUDOS_H_ */
```

## src/feat_conditional.c
```c
#include "feat_conditional.h"

#include <stdarg.h>
#include <zephyr/sys/printk.h>
#include <zephyr/logging/log.h>


#ifdef CONFIG_FEATURE_CONDITIONAL_USE_LOG
LOG_MODULE_REGISTER(feat_conditional, LOG_LEVEL_INF);

static void log_with_log(const char *fmt, ...)
{
    char buf[96];
    va_list args;

    va_start(args, fmt);
    vsnprintk(buf, sizeof(buf), fmt, args);
    va_end(args);

    LOG_INF("%s", buf);
}
static void (*feature_conditional_logger)(const char *fmt, ...) = log_with_log;
#else
static void log_with_printk(const char *fmt, ...)
{
    va_list args;

    va_start(args, fmt);
    vprintk(fmt, args);
    va_end(args);
}
static void (*feature_conditional_logger)(const char *fmt, ...) = log_with_printk;
#endif


void feature_conditional(void)
{
    if(IS_ENABLED(CONFIG_FEATURE_CONDITIONAL_USE_LOG)) {
        feature_conditional_logger("Feature conditional is enabled with LOG!\n");
    } else {
        feature_conditional_logger("Feature conditional is enabled with PRINTK!\n");
    }
}

void feature_conditional_config(void)
{
    feature_conditional_logger("Feature Baudrate: %d\n", CONFIG_FEATURE_CONDITIONAL_BAUDRATE);
    feature_conditional_logger("Feature Timeout: %d\n", CONFIG_FEATURE_CONDITIONAL_TIMEOUT);
}
```

## src/saludos.c
```c
#include "saludos.h"

#include <zephyr/sys/printk.h>

void saludo_base(void)
{
    printk("Hola desde saludo_base()!\n");
}
```
